## mining-standalone/main/Kconfig.projbuild
```kconfig
menu "Mining Standalone Configuration"

config MINE_WIFI_SSID
    string "WiFi SSID"
    default ""
    help
        SSID of the WiFi network the ESP32 will join to reach the stratum pool.

config MINE_WIFI_PASS
    string "WiFi Password"
    default ""
    help
        Password for the WiFi network.

config MINE_STRATUM_HOST
    string "Stratum Pool Host"
    default "stratum+tcp://pool.supportxmr.com"
    help
        Hostname or IP of the stratum pool.

config MINE_STRATUM_PORT
    int "Stratum Pool Port"
    default 3333
    help
        TCP port of the stratum pool.

config MINE_STRATUM_USER
    string "Stratum Username / Wallet Address"
    default ""
    help
        Username or wallet address for the stratum pool.

config MINE_STRATUM_PASS
    string "Stratum Password"
    default "x"
    help
        Password for the stratum pool (usually 'x' for Bitcoin pools).

endmenu
```

## mining-standalone/sdkconfig.defaults
```kconfig
# --- ESP32-S3 target ---
CONFIG_IDF_TARGET="esp32s3"

# --- Flash / Partition ---
CONFIG_ESPTOOLPY_FLASHSIZE_16MB=y
CONFIG_PARTITION_TABLE_CUSTOM=y
CONFIG_PARTITION_TABLE_CUSTOM_FILENAME="partitions.csv"

# --- PSRAM (ESP32-S3 N8R8 / tollgate boards) ---
CONFIG_SPIRAM=y
CONFIG_SPIRAM_MODE_OCT=y
CONFIG_SPIRAM_SPEED_80M=y
CONFIG_SPIRAM_USE_MALLOC=y
CONFIG_SPIRAM_MALLOC_ALWAYSINTERNAL=16384

# --- WiFi ---
CONFIG_ESP_WIFI_ENABLED=y
CONFIG_ESP_WIFI_NVS_ENABLED=y

# --- FreeRTOS ---
CONFIG_FREERTOS_HZ=1000

# --- LWIP ---
CONFIG_LWIP_MAX_SOCKETS=16

# --- Logging ---
CONFIG_LOG_DEFAULT_LEVEL_INFO=y
```
